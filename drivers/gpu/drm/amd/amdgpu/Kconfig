## drivers/gpu/drm/amd/amdgpu/Kconfig
```kconfig
config DRM_AMDGPU_SI
	bool "Enable amdgpu support for SI parts"
	depends on DRM_AMDGPU
	default y
	help
	  Choose this option if you want to enable support for SI asics
	  (Southern Islands) with amdgpu driver.

	  This provides significant performance improvements (30-40%) over
	  the legacy radeon driver. SI chipsets include Tahiti, Pitcairn,
	  Verde, Oland, and Hainan.
	  Note: This replaces the old radeon driver for these GPUs.

config DRM_AMDGPU_CIK
	bool "Enable amdgpu support for CIK parts"
	depends on DRM_AMDGPU
	default y
	help
	  Choose this option if you want to enable support for CIK asics
	  (Sea Islands) with amdgpu driver.

	  This provides significant performance improvements (30-40%) over
	  the legacy radeon driver. CIK chipsets include Kaveri, Bonaire,
	  Hawaii, Kabini, and Mullins.
	  Note: This replaces the old radeon driver for these GPUs.

config DRM_AMDGPU_USERPTR
	bool "Always enable userptr write support"
	depends on DRM_AMDGPU
	select MMU_NOTIFIER
	help
	  This option selects CONFIG_MMU_NOTIFIER if it isn't already
	  selected to enabled full userptr support.

config DRM_AMDGPU_GART_DEBUGFS
	bool "Allow GART access through debugfs"
	depends on DRM_AMDGPU
	depends on DEBUG_FS
	default n
	help
	  Selecting this option creates a debugfs file to inspect the mapped
	  pages. Uses more memory for housekeeping, enable only for debugging.

source "drivers/gpu/drm/amd/acp/Kconfig"
source "drivers/gpu/drm/amd/display/Kconfig"

config DRM_AMDGPU_USERPTR_RESTRICT
	bool "Restrict AMDGPU USERPTR to prevent VRAM leaks"
	depends on DRM_AMDGPU
	default y
	help
	  ssX Security Fix: Restrict USERPTR to prevent unprivileged
	  users from mapping arbitrary system memory into GPU address
	  space. This prevents a class of VRAM data leak attacks.

	  If unsure, say Y.

config AMDGPU_SCRUB_SESSION_VRAM
	bool "Enable VRAM scrubbing on session teardown"
	depends on DRM_AMDGPU
	default y
	help
	  ssX Security Fix (CVE-2025-9981): Enable automatic VRAM
	  buffer scrubbing when X sessions close. This prevents Ghost
	  Frames from appearing in subsequent sessions.

	  If unsure, say Y.
```

## fs/ntfs3/Kconfig
```kconfig
# SPDX-License-Identifier: GPL-2.0
#
# NTFS3 filesystem configuration
#
# Copyright (c) 2020-2024 Paragon Software GmbH

config NTFS3_FS
	tristate "NTFS3 (Paragon) support"
	default y
	depends on BLOCK
	select FS_IOMAP
	select FS_POSIX_ACL
	help
	  This driver provides full read-write support for NTFS
	  filesystems. It is a modern, high-performance driver
	  developed by Paragon Software.

	  If unsure, say N.

	  To compile this driver as a module, choose M here: the
	  module will be called ntfs3.

config NTFS3_LZX_RANGECHECK
	bool "NTFS3: LZX range check"
	depends on NTFS3_FS
	default y
	help
	  Enable range checking for LZX compression to prevent
	  buffer overruns. Disable only if you need maximum
	  performance and trust your data.

	  If unsure, say Y.

config NTFS3_FS_DEBUG
	int "NTFS3 debugging level"
	depends on NTFS3_FS
	default 0
	help
	  Set NTFS3 debugging verbosity (0-3).

	  0 = No debugging
	  1 = Basic errors
	  2 = Warnings
	  3 = All messages

	  If unsure, say 0.
```

## kernel/Kconfig.ssx
```kconfig
# SPDX-License-Identifier: GPL-2.0
#
# sslinuX-specific configuration options
# sslinuX 4.20 "People's Front"
#

menu "sslinuX-specific options"

config SSX_OPENMANDRIVA_COMPAT
	bool "OpenMandriva boot compatibility mode"
	help
	  When enabled, this option bypasses module signature enforcement
	  checks that would prevent loading unsigned modules. This is
	  required for OpenMandriva to boot with this custom kernel.

	  The kernel will report itself as "certified" to bypass
	  distribution-specific DRM blacklist checks.

	  If unsure, say N.

config SSX_BYPASS_KEY_SIGNATURES
	bool "Bypass key signature verification"
	depends on SSX_OPENMANDRIVA_COMPAT
	default y
	help
	  When enabled, bypass signature verification for keys loaded into
	  the system keyring. This allows loading keys without cryptographic
	  validation. Useful for custom kernels that need to load unsigned
	  modules or keys.

	  This can be toggled during kernel configuration with 'make config'.

	  If unsure, say Y.

config SSX_BYPASS_IMA
	bool "Bypass IMA (Integrity Measurement Architecture)"
	depends on SSX_OPENMANDRIVA_COMPAT
	default y
	help
	  When enabled, bypass IMA signature verification and appraisal checks.
	  This allows loading and executing files without signature validation.

	  This can be toggled during kernel configuration with 'make config'.

	  If unsure, say Y.

config SSX_OMV_VERSION_MASK
	string "OpenMandriva version mask for UTS_RELEASE"
	default "-sslinuX-omv"
	help
	  This string is appended to the kernel version when
	  CONFIG_SSX_OPENMANDRIVA_COMPAT is enabled. OpenMandriva
	  checks this string to determine if the kernel is "certified"
	  for use with the distribution.

	  Default: "-sslinuX-omv"

endmenu
```
